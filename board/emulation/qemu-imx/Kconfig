## board/emulation/qemu-imx/Kconfig
```kconfig
config QEMU_IMX_ROM
	bool
	select BINMAN
	select SUPPORT_SPL
	select ENABLE_ARM_SOC_BOOT0_HOOK
	help
	  Common support for the virtual i.MX boot ROMs for QEMU.

if QEMU_IMX_ROM

config SYS_BOARD
	default "qemu-imx"

config SYS_VENDOR
	default "emulation"

config SYS_CONFIG_NAME
	default "qemu-imx8m-rom" if ARCH_IMX8M
	default "qemu-imx53-rom" if MX53
	default "qemu-imx6-rom" if MX6
	default "qemu-imx7-rom" if MX7

config SPL_LDSCRIPT
	default "board/emulation/qemu-imx/u-boot-spl-imx8m-rom.lds" if ARCH_IMX8M
	default "board/emulation/qemu-imx/u-boot-spl-armv7-rom.lds" if MX53 || MX6 || MX7

endif
```

## configs/qemu_imx53_rom_defconfig
```kconfig
CONFIG_ARM=y
CONFIG_ARCH_MX5=y
CONFIG_TEXT_BASE=0x77800000
CONFIG_SYS_MALLOC_LEN=0x100000
CONFIG_SYS_MALLOC_F_LEN=0x8000
CONFIG_SPL_LIBCOMMON_SUPPORT=y
CONFIG_SPL_LIBGENERIC_SUPPORT=y
CONFIG_ENV_SIZE=0x2000
CONFIG_TARGET_QEMU_IMX53_ROM=y
CONFIG_DEFAULT_DEVICE_TREE="qemu-imx53-rom"
CONFIG_SPL_MMC=y
CONFIG_SPL_SERIAL=y
CONFIG_SPL_TEXT_BASE=0x0
CONFIG_SPL_MAX_SIZE=0x10000
CONFIG_SPL_STACK=0xf8020000
CONFIG_SPL_HAS_BSS_LINKER_SECTION=y
CONFIG_SPL_SEPARATE_BSS=y
CONFIG_SPL_BSS_START_ADDR=0xf8000000
CONFIG_SPL_BSS_MAX_SIZE=0x4000
CONFIG_SPL_SYS_MALLOC_F_LEN=0x8000
CONFIG_SPL_SYS_MALLOC=y
CONFIG_SPL_HAS_CUSTOM_MALLOC_START=y
CONFIG_SPL_CUSTOM_SYS_MALLOC_ADDR=0xf8004000
CONFIG_SPL_SYS_MALLOC_SIZE=0x8000
CONFIG_SYS_LOAD_ADDR=0x72000000
CONFIG_SPL=y
CONFIG_SPL_SYS_THUMB_BUILD=y
# CONFIG_SPL_BINMAN_UBOOT_SYMBOLS is not set
# CONFIG_SPL_RAW_IMAGE_SUPPORT is not set
# CONFIG_SPL_LEGACY_IMAGE_FORMAT is not set
CONFIG_SPL_SYS_MMCSD_RAW_MODE=y
CONFIG_SYS_MMCSD_RAW_MODE_U_BOOT_SECTOR=0x2
# CONFIG_SPL_FS_FAT is not set
# CONFIG_SPL_SHARES_INIT_SP_ADDR is not set
CONFIG_SPL_HAVE_INIT_STACK=y
# CONFIG_SPL_BOARD_INIT is not set
# CONFIG_CMDLINE is not set
# CONFIG_EFI_LOADER is not set
CONFIG_NO_NET=y
CONFIG_OF_CONTROL=y
CONFIG_SPL_OF_CONTROL=y
CONFIG_SPL_DM=y
CONFIG_FSL_ESDHC_IMX=y
CONFIG_MXC_UART=y
# CONFIG_SPL_GPIO is not set
# CONFIG_SPL_POWER is not set
# CONFIG_SPL_I2C is not set
CONFIG_SPL_CRYPTO=y
CONFIG_RSA=y
CONFIG_SPL_RSA=y
CONFIG_RSA_VERIFY_WITH_PKEY=y
CONFIG_SPL_RSA_VERIFY_WITH_PKEY=y
CONFIG_SPL_SHA256=y
CONFIG_SPL_X509_CERTIFICATE_PARSER=y
CONFIG_SPL_PKCS7_MESSAGE_PARSER=y
```

## configs/qemu_imx6ul_rom_defconfig
```kconfig
CONFIG_ARM=y
CONFIG_ARCH_MX6=y
CONFIG_TEXT_BASE=0x87800000
CONFIG_SYS_MALLOC_LEN=0x100000
CONFIG_SYS_MALLOC_F_LEN=0x8000
CONFIG_SPL_LIBCOMMON_SUPPORT=y
CONFIG_SPL_LIBGENERIC_SUPPORT=y
CONFIG_ENV_SIZE=0x2000
CONFIG_MX6UL=y
CONFIG_TARGET_QEMU_IMX6UL_ROM=y
CONFIG_DEFAULT_DEVICE_TREE="qemu-imx6ul-rom"
CONFIG_SPL_SYS_MALLOC_F_LEN=0x4000
CONFIG_SPL_MMC=y
CONFIG_SPL_SERIAL=y
CONFIG_SPL_STACK=0x907000
CONFIG_SPL_TEXT_BASE=0x0
CONFIG_SPL_BSS_START_ADDR=0x900000
CONFIG_SPL_BSS_MAX_SIZE=0x1800
CONFIG_SPL=y
# CONFIG_EFI_LOADER is not set
CONFIG_SPL_MAX_SIZE=0x18000
CONFIG_SPL_PAD_TO=0x18000
# CONFIG_SPL_BINMAN_UBOOT_SYMBOLS is not set
# CONFIG_SPL_LEGACY_IMAGE_FORMAT is not set
CONFIG_SPL_SYS_MALLOC_SIMPLE=y
CONFIG_SYS_MMCSD_RAW_MODE_U_BOOT_SECTOR=0x2
# CONFIG_CMDLINE is not set
CONFIG_OF_CONTROL=y
CONFIG_SPL_OF_CONTROL=y
CONFIG_NO_NET=y
CONFIG_SPL_DM=y
CONFIG_FSL_USDHC=y
CONFIG_MXC_UART=y
```

## configs/qemu_imx7d_rom_defconfig
```kconfig
CONFIG_ARM=y
CONFIG_ARCH_MX7=y
CONFIG_SYS_MALLOC_LEN=0x100000
CONFIG_SYS_MALLOC_F_LEN=0x8000
CONFIG_SPL_LIBCOMMON_SUPPORT=y
CONFIG_SPL_LIBGENERIC_SUPPORT=y
CONFIG_ENV_SIZE=0x2000
CONFIG_DEFAULT_DEVICE_TREE="qemu-imx7d-rom"
CONFIG_TARGET_QEMU_IMX7D_ROM=y
CONFIG_SPL_SYS_MALLOC_F_LEN=0x1000
CONFIG_SPL_MMC=y
CONFIG_SPL_SERIAL=y
CONFIG_SPL_STACK=0x907000
CONFIG_SPL_TEXT_BASE=0x0
CONFIG_SPL_HAS_BSS_LINKER_SECTION=y
CONFIG_SPL_BSS_START_ADDR=0x900000
CONFIG_SPL_BSS_MAX_SIZE=0x1800
CONFIG_SYS_LOAD_ADDR=0x82000000
CONFIG_SPL=y
# CONFIG_EFI_LOADER is not set
CONFIG_SPL_MAX_SIZE=0x18000
CONFIG_SPL_PAD_TO=0x18000
# CONFIG_SPL_BINMAN_UBOOT_SYMBOLS is not set
# CONFIG_SPL_RAW_IMAGE_SUPPORT is not set
# CONFIG_SPL_LEGACY_IMAGE_FORMAT is not set
CONFIG_SPL_SEPARATE_BSS=y
CONFIG_SPL_SYS_MALLOC=y
CONFIG_SPL_HAS_CUSTOM_MALLOC_START=y
CONFIG_SPL_CUSTOM_SYS_MALLOC_ADDR=0x901800
CONFIG_SPL_SYS_MALLOC_SIZE=0x3000
CONFIG_SYS_MMCSD_RAW_MODE_U_BOOT_SECTOR=0x2
CONFIG_SPL_CRYPTO=y
# CONFIG_CMDLINE is not set
CONFIG_OF_CONTROL=y
CONFIG_SPL_OF_CONTROL=y
# CONFIG_ENV_IS_IN_MMC is not set
CONFIG_NO_NET=y
CONFIG_SPL_DM=y
CONFIG_FSL_USDHC=y
CONFIG_MXC_UART=y
CONFIG_RSA=y
CONFIG_SPL_RSA=y
CONFIG_RSA_VERIFY_WITH_PKEY=y
CONFIG_SPL_RSA_VERIFY_WITH_PKEY=y
CONFIG_SPL_X509_CERTIFICATE_PARSER=y
CONFIG_SPL_PKCS7_MESSAGE_PARSER=y
```

## configs/qemu_imx8mm_rom_defconfig
```kconfig
CONFIG_ARM=y
CONFIG_ARCH_IMX8M=y
CONFIG_TEXT_BASE=0x40200000
CONFIG_SYS_MALLOC_LEN=0x100000
CONFIG_SYS_MALLOC_F_LEN=0x8000
CONFIG_SPL_LIBCOMMON_SUPPORT=y
CONFIG_SPL_LIBGENERIC_SUPPORT=y
CONFIG_ENV_SIZE=0x1000
CONFIG_DEFAULT_DEVICE_TREE="qemu-imx8mm-rom"
CONFIG_TARGET_QEMU_IMX8MM_ROM=y
CONFIG_SPL_MMC=y
CONFIG_SPL_SERIAL=y
CONFIG_SPL_TEXT_BASE=0x0
CONFIG_SPL_MAX_SIZE=0x3f000
CONFIG_SPL_STACK=0x91e000
CONFIG_SPL_HAS_BSS_LINKER_SECTION=y
CONFIG_SPL_SEPARATE_BSS=y
CONFIG_SPL_BSS_START_ADDR=0x900000
CONFIG_SPL_BSS_MAX_SIZE=0x4000
CONFIG_SPL_SYS_MALLOC_F_LEN=0x8000
CONFIG_SPL_SYS_MALLOC_SIMPLE=y
CONFIG_SYS_LOAD_ADDR=0x40480000
CONFIG_SPL=y
CONFIG_FIT=y
# CONFIG_SPL_LOAD_FIT is not set
# CONFIG_SPL_RAW_IMAGE_SUPPORT is not set
# CONFIG_SPL_LEGACY_IMAGE_FORMAT is not set
CONFIG_SPL_SYS_MMCSD_RAW_MODE=y
CONFIG_SYS_MMCSD_RAW_MODE_U_BOOT_SECTOR=0x42
# CONFIG_SPL_FS_FAT is not set
# CONFIG_SPL_SHARES_INIT_SP_ADDR is not set
CONFIG_SPL_HAVE_INIT_STACK=y
# CONFIG_SPL_BOARD_INIT is not set
# CONFIG_CMDLINE is not set
# CONFIG_EFI_LOADER is not set
CONFIG_NO_NET=y
CONFIG_OF_CONTROL=y
CONFIG_SPL_OF_CONTROL=y
CONFIG_SPL_DM=y
CONFIG_SPL_CLK_COMPOSITE_CCF=y
CONFIG_CLK_COMPOSITE_CCF=y
CONFIG_SPL_CLK_IMX8MM=y
CONFIG_CLK_IMX8MM=y
CONFIG_PINCTRL=y
CONFIG_SPL_PINCTRL=y
CONFIG_PINCTRL_IMX8M=y
CONFIG_MMC=y
CONFIG_DM_MMC=y
CONFIG_FSL_USDHC=y
CONFIG_DM_SERIAL=y
CONFIG_MXC_UART=y
# CONFIG_SPL_GPIO is not set
# CONFIG_SPL_POWER is not set
# CONFIG_SPL_I2C is not set
# CONFIG_SPL_WATCHDOG is not set
```

## configs/qemu_imx8mp_rom_defconfig
```kconfig
CONFIG_ARM=y
CONFIG_ARCH_IMX8M=y
CONFIG_TEXT_BASE=0x40200000
CONFIG_SYS_MALLOC_LEN=0x100000
CONFIG_SYS_MALLOC_F_LEN=0x8000
CONFIG_SPL_LIBCOMMON_SUPPORT=y
CONFIG_SPL_LIBGENERIC_SUPPORT=y
CONFIG_ENV_SIZE=0x1000
CONFIG_DEFAULT_DEVICE_TREE="qemu-imx8mp-rom"
CONFIG_TARGET_QEMU_IMX8MP_ROM=y
CONFIG_SPL_MMC=y
CONFIG_SPL_SERIAL=y
CONFIG_SPL_TEXT_BASE=0x0
CONFIG_SPL_MAX_SIZE=0x3f000
CONFIG_SPL_STACK=0x91e000
CONFIG_SPL_HAS_BSS_LINKER_SECTION=y
CONFIG_SPL_SEPARATE_BSS=y
CONFIG_SPL_BSS_START_ADDR=0x900000
CONFIG_SPL_BSS_MAX_SIZE=0x4000
CONFIG_SPL_SYS_MALLOC_F_LEN=0x10000
CONFIG_SPL_SYS_MALLOC=y
CONFIG_SPL_HAS_CUSTOM_MALLOC_START=y
CONFIG_SPL_CUSTOM_SYS_MALLOC_ADDR=0x904000
CONFIG_SPL_SYS_MALLOC_SIZE=0x6000
CONFIG_SYS_LOAD_ADDR=0x40480000
CONFIG_SPL=y
CONFIG_FIT=y
# CONFIG_SPL_LOAD_FIT is not set
# CONFIG_SPL_RAW_IMAGE_SUPPORT is not set
# CONFIG_SPL_LEGACY_IMAGE_FORMAT is not set
CONFIG_SPL_SYS_MMCSD_RAW_MODE=y
CONFIG_SYS_MMCSD_RAW_MODE_U_BOOT_SECTOR=0x40
# CONFIG_SPL_FS_FAT is not set
# CONFIG_SPL_SHARES_INIT_SP_ADDR is not set
CONFIG_SPL_HAVE_INIT_STACK=y
# CONFIG_SPL_BOARD_INIT is not set
# CONFIG_CMDLINE is not set
# CONFIG_EFI_LOADER is not set
CONFIG_NO_NET=y
CONFIG_OF_CONTROL=y
CONFIG_SPL_OF_CONTROL=y
CONFIG_SPL_DM=y
CONFIG_SPL_CLK_COMPOSITE_CCF=y
CONFIG_CLK_COMPOSITE_CCF=y
CONFIG_SPL_CLK_IMX8MP=y
CONFIG_CLK_IMX8MP=y
CONFIG_PINCTRL=y
CONFIG_SPL_PINCTRL=y
CONFIG_PINCTRL_IMX8M=y
CONFIG_MMC=y
CONFIG_DM_MMC=y
CONFIG_FSL_USDHC=y
CONFIG_DM_SERIAL=y
CONFIG_MXC_UART=y
# CONFIG_SPL_GPIO is not set
# CONFIG_SPL_POWER is not set
# CONFIG_SPL_I2C is not set
# CONFIG_SPL_WATCHDOG is not set
# CONFIG_ARMV8_CE_SHA256 is not set
CONFIG_SPL_CRYPTO=y
CONFIG_RSA=y
CONFIG_SPL_RSA=y
CONFIG_RSA_VERIFY_WITH_PKEY=y
CONFIG_SPL_RSA_VERIFY_WITH_PKEY=y
CONFIG_SPL_SHA256=y
CONFIG_SPL_X509_CERTIFICATE_PARSER=y
CONFIG_SPL_PKCS7_MESSAGE_PARSER=y
```
