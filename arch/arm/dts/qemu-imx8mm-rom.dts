// SPDX-License-Identifier: GPL-2.0+
/*
 * Device tree of the QEMU i.MX8MM virtual boot ROM
 */

#include "imx8mm-evk.dts"
#include "qemu-imx8m-rom.dtsi"

/ {
	model = "QEMU i.MX8MM virtual boot ROM";

	/* Image for QEMU's -bios option, sized like the boot ROM region */
	binman {
		filename = "imx8mm-boot.rom";
		size = <0x3f000>;
		pad-byte = <0x00>;

		u-boot-spl {
		};
	};
};
